#include "osprey_68.dtsi"

/ {
    kscan0: kscan0 {
        compatible = "zmk,kscan-gpio-matrix";
        diode-direction = "col2row";
        wakeup-source;

        col-gpios
            = <&shifter 0 GPIO_ACTIVE_HIGH>
            , <&shifter 1 GPIO_ACTIVE_HIGH>
            , <&shifter 2 GPIO_ACTIVE_HIGH>
            , <&shifter 3 GPIO_ACTIVE_HIGH>
            , <&shifter 4 GPIO_ACTIVE_HIGH>
            , <&shifter 5 GPIO_ACTIVE_HIGH>
            , <&shifter 6 GPIO_ACTIVE_HIGH>
            , <&shifter 7 GPIO_ACTIVE_HIGH>
            , <&shifter 8 GPIO_ACTIVE_HIGH>
            , <&shifter 9 GPIO_ACTIVE_HIGH>
            , <&shifter 10 GPIO_ACTIVE_HIGH>
            , <&shifter 11 GPIO_ACTIVE_HIGH>
            , <&shifter 12 GPIO_ACTIVE_HIGH>
            , <&shifter 13 GPIO_ACTIVE_HIGH>
            , <&shifter 14 GPIO_ACTIVE_HIGH>
            , <&shifter 15 GPIO_ACTIVE_HIGH>
            ;

        row-gpios
            = <&pro_micro 6 (GPIO_ACTIVE_HIGH | GPIO_PULL_DOWN)>
            , <&pro_micro 7 (GPIO_ACTIVE_HIGH | GPIO_PULL_DOWN)>
            , <&pro_micro 8 (GPIO_ACTIVE_HIGH | GPIO_PULL_DOWN)>
            , <&pro_micro 9 (GPIO_ACTIVE_HIGH | GPIO_PULL_DOWN)>
            , <&pro_micro 10 (GPIO_ACTIVE_HIGH | GPIO_PULL_DOWN)>
            ;
    };
};

&physical_layout_osprey_68 {
    kscan = <&kscan0>;
};

